## br-ext-tree/Config.in
```kconfig
menu "Custom"
	source "$BR2_EXTERNAL_ALBERT_PATH/package/albert-ui/Config.in"
	source "$BR2_EXTERNAL_ALBERT_PATH/package/albert-temperature-sensor/Config.in"
endmenu
```

## br-ext-tree/package/albert-temperature-sensor/Config.in
```kconfig
config BR2_PACKAGE_ALBERT_TEMPERATURE_SENSOR
	bool "albert-temperature-sensor"
	help
		Provides an interface to the temperature sensor via a Systemd Dbus
		server at org.albert.TemperatureSensor
```

## br-ext-tree/package/albert-ui/Config.in
```kconfig
config BR2_PACKAGE_ALBERT_UI
	bool "albert-ui"
	help
        raspberry pi 3 sensor controller QT app
```

## br-ext-tree/package/joomby/Config.in
```kconfig
config BR2_PACKAGE_JOOMBY
	bool "joomby"
	help
        raspberry pi 3 sensor controller QT app
```

## br-ext-tree/package/temperature-sensor/Config.in
```kconfig
config BR2_PACKAGE_TEMPERATURE_SENSOR
	bool "temperature-sensor"
	help
		Provides an interface to the temperature sensor via a Systemd Dbus
		server at org.joomby.TemperatureSensor
```

## src/Config.in
```kconfig
config BR2_PACKAGE_PI_MAIN_CONTROLLER
	bool "pi-main-controller"
	help
        Main controller software for orchestrating tasks with a fleet of
        devices and various EC2 containers.
```
